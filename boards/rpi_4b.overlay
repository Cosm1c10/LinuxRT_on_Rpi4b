/*
 * Sentinel-RT Device Tree Overlay — Raspberry Pi 4 Model B
 *
 * Pin assignments:
 *   GPIO 17 (Physical 11) — SW-420 Vibration sensor (digital input)
 *   GPIO 27 (Physical 13) — LM393 Sound sensor     (digital input)
 *   GPIO  4 (Physical  7) — DS18B20 1-Wire temp     (input / bit-bang output)
 *   GPIO 22 (Physical 15) — Status LED              (output, optional)
 *
 *   I2C1 SDA = GPIO 2 (Physical 3)
 *   I2C1 SCL = GPIO 3 (Physical 5)
 *   ADS1115 ADC @ 0x48 on I2C1 (reads ACS712 current sensor output)
 *
 * Apply: place this file in boards/ at the project root.
 * west build -b rpi_4b . automatically picks it up.
 */

/ {
    chosen {
        zephyr,console = &uart0;
        zephyr,shell-uart = &uart0;
    };
};

/*
 * Enable I2C1 (BCM2711 BSC1) at standard speed.
 * sensors.c uses DT_NODELABEL(i2c1) to obtain the device pointer.
 */
&i2c1 {
    status = "okay";
    clock-frequency = <I2C_BITRATE_STANDARD>;  /* 100 kHz */
};

/*
 * The BCM2711 GPIO controller is exposed as "gpio0" in Zephyr's RPi 4 DTS.
 * sensors.c uses DT_NODELABEL(gpio0) — no extra node needed here.
 * Pin directions are configured at runtime via gpio_pin_configure().
 */
